## conf/distro/include/webos-preferred-providers.inc
```bitbake
# Prefer libjpeg-turbo from meta-oe
PREFERRED_PROVIDER_jpeg = "libjpeg-turbo"
PREFERRED_PROVIDER_jpeg-native = "libjpeg-turbo-native"
PREFERRED_PROVIDER_qmake-webos-native = "qt4-native"
PREFERRED_PROVIDER_qt4-webos = "qt4-embedded"
```
